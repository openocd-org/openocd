## contrib/buildroot/openocd_be_defconfig
```kconfig
# SPDX-License-Identifier: GPL-2.0-or-later

BR2_armeb=y
BR2_cortex_a7=y
BR2_TOOLCHAIN_EXTERNAL=y
BR2_PACKAGE_OPENOCD=y
BR2_PACKAGE_OPENOCD_FTDI=y
BR2_PACKAGE_OPENOCD_STLINK=y
BR2_PACKAGE_OPENOCD_TI_ICDI=y
BR2_PACKAGE_OPENOCD_ULINK=y
BR2_PACKAGE_OPENOCD_UBLASTER2=y
BR2_PACKAGE_OPENOCD_JLINK=y
BR2_PACKAGE_OPENOCD_OSDBM=y
BR2_PACKAGE_OPENOCD_OPENDOUS=y
BR2_PACKAGE_OPENOCD_AICE=y
BR2_PACKAGE_OPENOCD_VSLLINK=y
BR2_PACKAGE_OPENOCD_USBPROG=y
BR2_PACKAGE_OPENOCD_RLINK=y
BR2_PACKAGE_OPENOCD_ARMEW=y
BR2_PACKAGE_OPENOCD_XDS110=y
BR2_PACKAGE_OPENOCD_PARPORT=y
BR2_PACKAGE_OPENOCD_VPI=y
BR2_PACKAGE_OPENOCD_UBLASTER=y
BR2_PACKAGE_OPENOCD_AMTJT=y
BR2_PACKAGE_OPENOCD_GW16012=y
BR2_PACKAGE_OPENOCD_PRESTO=y
BR2_PACKAGE_OPENOCD_OPENJTAG=y
BR2_PACKAGE_OPENOCD_BUSPIRATE=y
BR2_PACKAGE_OPENOCD_SYSFS=y
```
